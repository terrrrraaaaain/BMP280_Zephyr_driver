## drivers/sensor/Kconfig.bmp280
```kconfig
# Copyright (c) 2026 Franciszek Trzeciak
# SPDX-License-Identifier: Apache-2.0

config CUSTOM_BMP280
    bool "BMP280 Pressure and temperature sensor (FT)"
    default y
    depends on DT_HAS_CUSTOM_BMP280_ENABLED
    depends on SENSOR
    help
        Enable driver for unified BMP280 sensor

config CUSTOM_BMP280_USE_ALTIMETER
    bool "CUSTOM_BMP280 altimeter functionality (FT)"
    default n
    depends on DT_HAS_CUSTOM_BMP280_ENABLED
    help
        Enable altimeter functionality for unified BMP280 sensor driver
```

## dts/bindings/sensor/custom,bmp280-common.yaml
```yaml
# Copyright (c) 2026 Franciszek Trzeciak
# SPDX-License-Identifier: Apache-2.0

description: BMP280 pressure and temperature sensor. Common properties
include: sensor-device.yaml
properties:
  mode:
    type: int
    required: false
    default: 0 #BMP280_MODE_SLEEP
    description: |
      Initial power mode index. 
      Refer to <dt-bindings/sensor/custom_bmp280.h> for valid indices.
  t-standby:
    type: int
    required: false
    default: 0 #BMP280_T_STANDBY_0_5MS
    description: |
      Time between maserements in normal mode. THIS IS INDEX.
      Refer to <dt-bindings/sensor/custom_bmp280.h> for valid indices.
  iir-filter:
    type: int
    required: false
    default: 0 #BMP280_FILTER_OFF
    description: |
      IIR Filter coefficient. THIS IS INDEX.
      Refer to <dt-bindings/sensor/custom_bmp280.h> for valid indices.
  temperature-oversampling:
    type: int
    required: false
    default: 1 #BMP280_OVERSAMPLING_X1
    description: |
      Temperature oversampling. THIS IS INDEX.
      Refer to <dt-bindings/sensor/custom_bmp280.h> for valid indices.
  pressure-oversampling:
    type: int
    required: false
    default: 1 #BMP280_OVERSAMPLING_X1
    description: |
      Temperature oversampling. THIS IS INDEX.
      Refer to <dt-bindings/sensor/custom_bmp280.h> for valid indices.
```

## dts/bindings/sensor/custom,bmp280-i2c.yaml
```yaml
# Copyright (c) 2026 Franciszek Trzeciak
# SPDX-License-Identifier: Apache-2.0
description: BMP280 pressure and temperature sensor - I2C specific
compatible: "custom,bmp280"
on-bus: i2c
include: 
  - custom,bmp280-common.yaml
  - i2c-device.yaml
```

## dts/bindings/sensor/custom,bmp280-spi.yaml
```yaml
# Copyright (c) 2026 Franciszek Trzeciak
# SPDX-License-Identifier: Apache-2.0
description: BMP280 pressure and temperature sensor
compatible: "custom,bmp280"
on-bus: spi
include: 
  - custom,bmp280-common.yaml
  - spi-device.yaml

properties:
  spi-3-wire-enable:
    type: boolean
    required: false
    description: |
      SPI 3 Wire ON/OFF. SPI 4 Wire instead if not present.
      
```

## dts/bindings/sensor/custom,bmp280.yaml
```yaml
# Copyright (c) 2026 Franciszek Trzeciak
# SPDX-License-Identifier: Apache-2.0

description: BMP280 pressure and temperature sensor
compatible: "custom,bmp280"
on-bus: i2c
include: sensor-device.yaml
properties:
  reg:
    required: true
```
